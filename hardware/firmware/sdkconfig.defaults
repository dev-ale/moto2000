## hardware/firmware/sdkconfig.defaults
```kconfig
# ScramScreen default sdkconfig
# Values here are applied on first build; edit via `idf.py menuconfig` afterward.

CONFIG_IDF_TARGET="esp32s3"

# Flash and PSRAM — Waveshare board ships with 16MB flash + 8MB PSRAM
CONFIG_ESPTOOLPY_FLASHSIZE_16MB=y
CONFIG_ESPTOOLPY_FLASHSIZE="16MB"
CONFIG_SPIRAM=y
CONFIG_SPIRAM_MODE_OCT=y
CONFIG_SPIRAM_SPEED_80M=y
# Reserve enough internal RAM for SPI DMA bounce buffers used by the LVGL
# framebuffer flush. NimBLE consumes a lot of internal RAM at runtime, and
# without this reserve the SPI master fails to allocate priv TX buffers
# (~46 KB) when rendering screens after BLE connect.
CONFIG_SPIRAM_MALLOC_RESERVE_INTERNAL=131072

# Partition table — custom to reserve space for OTA + factory + NVS
CONFIG_PARTITION_TABLE_CUSTOM=y
CONFIG_PARTITION_TABLE_CUSTOM_FILENAME="partitions.csv"

# FreeRTOS
CONFIG_FREERTOS_HZ=1000

# Bluetooth — NimBLE stack, BLE only
CONFIG_BT_ENABLED=y
CONFIG_BT_NIMBLE_ENABLED=y
CONFIG_BT_CONTROLLER_ENABLED=y
# Persist BLE bonds (LTK, IRK) to NVS so pairing survives reboots.
# Without this, every firmware restart loses the bond and iOS can no
# longer encrypt → enc status=7 → reconnect loop forever.
CONFIG_BT_NIMBLE_NVS_PERSIST=y
# NimBLE ACL pools left at the IDF default — the BLE-pushed OTA flow
# is gone (replaced with WiFi HTTPS OTA) so the bulk-write pressure
# that justified bumping these is no longer relevant. Bumping them
# eats ~12 KB of internal RAM and starves the SPI DMA pool, breaking
# the display.

# Logging
CONFIG_LOG_DEFAULT_LEVEL_INFO=y

# Compiler
CONFIG_COMPILER_WARN_WRITE_STRINGS=y
CONFIG_COMPILER_OPTIMIZATION_SIZE=y

# LVGL fonts needed by ScramScreen screens
CONFIG_LV_FONT_MONTSERRAT_10=y
CONFIG_LV_FONT_MONTSERRAT_12=y
CONFIG_LV_FONT_MONTSERRAT_14=y
CONFIG_LV_FONT_MONTSERRAT_16=y
CONFIG_LV_FONT_MONTSERRAT_18=y
CONFIG_LV_FONT_MONTSERRAT_20=y
CONFIG_LV_FONT_MONTSERRAT_22=y
CONFIG_LV_FONT_MONTSERRAT_24=y
CONFIG_LV_FONT_MONTSERRAT_28=y
CONFIG_LV_FONT_MONTSERRAT_36=y
CONFIG_LV_FONT_MONTSERRAT_48=y

# LVGL color swap for big-endian display controller
CONFIG_LV_COLOR_16_SWAP=y
```
